## linux/buildroot/configs/mlogv32_defconfig
```kconfig
BR2_riscv=y
BR2_riscv_custom=y
BR2_RISCV_ISA_RVM=y
BR2_RISCV_ISA_RVA=y
BR2_RISCV_32=y
BR2_TOOLCHAIN_EXTERNAL=y
BR2_TOOLCHAIN_EXTERNAL_CUSTOM_PREFIX="$(ARCH)-unknown-linux-gnu"
BR2_TOOLCHAIN_EXTERNAL_HEADERS_6_6=y
BR2_TOOLCHAIN_EXTERNAL_CUSTOM_GLIBC=y
# BR2_TOOLCHAIN_EXTERNAL_INET_RPC is not set
BR2_TOOLCHAIN_EXTERNAL_CXX=y
BR2_TOOLCHAIN_EXTERNAL_FORTRAN=y
BR2_TOOLCHAIN_EXTERNAL_OPENMP=y
BR2_GLOBAL_PATCH_DIR="$(BR2_EXTERNAL_MLOGV32_PATH)/patches"
BR2_RELRO_NONE=y
BR2_TARGET_GENERIC_HOSTNAME="mlogv32"
BR2_ROOTFS_DEVICE_TABLE="system/device_table.txt $(BR2_EXTERNAL_MLOGV32_PATH)/board/mlogv32/device_table.txt"
BR2_ROOTFS_MERGED_USR=y
# BR2_TARGET_GENERIC_REMOUNT_ROOTFS_RW is not set
BR2_ROOTFS_OVERLAY="$(BR2_EXTERNAL_MLOGV32_PATH)/board/mlogv32/overlay"
BR2_LINUX_KERNEL=y
BR2_LINUX_KERNEL_USE_CUSTOM_CONFIG=y
BR2_LINUX_KERNEL_CUSTOM_CONFIG_FILE="$(BR2_EXTERNAL_MLOGV32_PATH)/board/mlogv32/linux.config"
BR2_LINUX_KERNEL_EXT_MLOGV32_DRIVERS=y
BR2_PACKAGE_BUSYBOX_CONFIG="$(BR2_EXTERNAL_MLOGV32_PATH)/board/mlogv32/busybox.config"
BR2_PACKAGE_CA_CERTIFICATES=y
BR2_PACKAGE_READLINE=y
BR2_PACKAGE_IPERF3=y
BR2_PACKAGE_OPENRESOLV=y
BR2_PACKAGE_PPPD=y
BR2_TARGET_ROOTFS_CRAMFS=y
BR2_TARGET_ROOTFS_CRAMFS_XIP=y
# BR2_TARGET_ROOTFS_TAR is not set
BR2_TARGET_OPENSBI=y
BR2_TARGET_OPENSBI_CUSTOM_GIT=y
BR2_TARGET_OPENSBI_CUSTOM_REPO_URL="https://github.com/riscv-software-src/opensbi"
BR2_TARGET_OPENSBI_CUSTOM_REPO_VERSION="v1.7"
BR2_TARGET_OPENSBI_PLAT="mlogv32"
# BR2_TARGET_OPENSBI_INSTALL_DYNAMIC_IMG is not set
BR2_TARGET_OPENSBI_ADDITIONAL_VARIABLES="PLATFORM_DIR=$(BR2_EXTERNAL_MLOGV32_PATH)/opensbi/platform FW_FDT_PATH=$(BR2_EXTERNAL_MLOGV32_PATH)/board/mlogv32/dts/mlogv32.dtb"
BR2_PACKAGE_HOST_CRAMFS=y
```

## linux/buildroot/opensbi/platform/mlogv32/Kconfig
```kconfig
# SPDX-License-Identifier: BSD-2-Clause

#
# All mandatory drivers or libraries for this platform should
# be directly selected by the PLATFORM_xyz kconfig symbol.
#
# All optional drivers or libraries for this platform should
# be enabled via configs/defconfig of this platform.
#
config PLATFORM_MLOGV32
	bool
	select FDT
	select SERIAL_XILINX_UARTLITE
	select TIMER_MTIMER
	default y
```

## linux/buildroot/opensbi/platform/mlogv32/configs/defconfig
```kconfig
# CONFIG_SBI_ECALL_IPI is not set
# CONFIG_SBI_ECALL_HSM is not set
# CONFIG_SBI_ECALL_SUSP is not set
# CONFIG_SBI_ECALL_CPPC is not set
# CONFIG_SBI_ECALL_FWFT is not set
# CONFIG_SBI_ECALL_VENDOR is not set
# CONFIG_SBI_ECALL_DBTR is not set
# CONFIG_SBI_ECALL_SSE is not set
# CONFIG_SBI_ECALL_MPXY is not set
CONFIG_FDT=y
```

## linux/buildroot/package/mlogv32-drivers/Config.in
```kconfig
config BR2_PACKAGE_MLOGV32_DRIVERS
    bool "mlogv32-drivers"
    depends on BR2_LINUX_KERNEL
```
